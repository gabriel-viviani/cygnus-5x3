## boards/shields/cygnus/Kconfig.defconfig
```kconfig
if SHIELD_CYGNUS_CENTRAL_DONGLE || SHIELD_CYGNUS_CENTRAL_LEFT

config ZMK_KEYBOARD_NAME
    default "Cygnus"

config ZMK_SPLIT_ROLE_CENTRAL
    default y

endif


if SHIELD_CYGNUS_CENTRAL_DONGLE || SHIELD_CYGNUS_CENTRAL_LEFT || SHIELD_CYGNUS_PERIPHERAL_LEFT || SHIELD_CYGNUS_PERIPHERAL_RIGHT

config ZMK_SPLIT
    default y

endif
```

## config/west.yml
```yaml
manifest:
  remotes:
    - name: zmkfirmware
      url-base: https://github.com/zmkfirmware
    - name: inorichi
      url-base: https://github.com/inorichi
  projects:
    - name: zmk
      remote: zmkfirmware
      revision: main
      import: app/west.yml
  self:
    path: config
```
