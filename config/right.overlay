/*
 * Copyright (c) 2020 Pete Johanson
 *
 * SPDX-License-Identifier: MIT
 */

#include "corne.dtsi"


{
    chosen {
        zmk,scan-mode = "matrix";
    };

    split {
        role = "peripheral";
    };

    matrix {
        rows = <5>;
        cols = <3>;
        diode-direction = "ROW2COL";

        row-gpios = <&gpio0 6 GPIO_ACTIVE_LOW>,
                    <&gpio0 7 GPIO_ACTIVE_LOW>,
                    <&gpio0 8 GPIO_ACTIVE_LOW>,
                    <&gpio0 9 GPIO_ACTIVE_LOW>,
                    <&gpio0 10 GPIO_ACTIVE_LOW>;

        col-gpios = <&gpio1 0 GPIO_ACTIVE_LOW>,
                    <&gpio1 1 GPIO_ACTIVE_LOW>,
                    <&gpio1 2 GPIO_ACTIVE_LOW>;
    };
};
